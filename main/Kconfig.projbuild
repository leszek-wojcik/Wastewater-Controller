## main/Kconfig.projbuild
```kconfig
menu "Controller Configuration"

    config WIFI_SSID
        string "WiFi SSID"
        default "myssid"
        help
            SSID (network name) for the example to connect to.

    config WIFI_PASSWORD
        string "WiFi Password"
        default "mypassword"
        help
            WiFi password (WPA or WPA2) for the example to use.

    config AWS_ENDPOINT
        string "AWS IoT Client ID"
        default ""
        help
            AWS IoT MQTT endpoint address

    config AWS_EXAMPLE_CLIENT_ID
        string "AWS IoT Client ID"
        default "myesp32"
        help
            AWS IoT Client ID for the example. Should be unique for every device.

endmenu
```

## wwc_device/main/Kconfig.projbuild
```kconfig
menu "WWC Configuration"

config WIFI_SSID
    string "WiFi SSID"
    default "myssid"
    help
        SSID (network name) for the example to connect to.

config WIFI_PASSWORD
    string "WiFi Password"
    default "mypassword"
    help
        WiFi password (WPA or WPA2) for the example to use.
        Can be left blank if the network has no security set.

config WIFIALT_SSID
    string "Alternative WiFi SSID"
    default "myssid"
    help
        SSID (network name) for the example to connect to.

config WIFIALT_PASSWORD
    string "Alternative WiFi Password"
    default "mypassword"
    help
        WiFi password (WPA or WPA2) for the example to use.
        Can be left blank if the network has no security set.


config AWS_CLIENT_ID
    string "AWS IoT Client ID"
    default "myesp32"
    help
        AWS IoT Client ID for the example. Should be unique for every device.

config AWS_IOT_MQTT_HOST
    string "MQTT HOST"
    default "aws"
    help
        MQTT HOST ADDRESS.

config AWS_IOT_MQTT_PORT
    int "MQTT PORT"
    default "8883"
    help
        MQTT HOST ADDRESS PORT.


config AWS_IOT_MQTT_TX_BUF_LEN
    int "MQTT TX Buffer Length"
    default 512
    range 32 65536
    help
        Maximum MQTT transmit buffer size. This is the maximum MQTT
        message length (including protocol overhead) which can be sent.

        Sending longer messages will fail.

config AWS_IOT_MQTT_RX_BUF_LEN
    int "MQTT RX Buffer Length"
    default 512
    range 32 65536
    help
        Maximum MQTT receive buffer size. This is the maximum MQTT
        message length (including protocol overhead) which can be
        received.

        Longer messages are dropped.

config AWS_IOT_MQTT_NUM_SUBSCRIBE_HANDLERS
    int "Maximum MQTT Topic Filters"
    default 5
    range 1 100
    help
        Maximum number of concurrent MQTT topic filters.


config AWS_IOT_MQTT_MIN_RECONNECT_WAIT_INTERVAL
    int "Auto reconnect initial interval (ms)"
    default 1000
    range 10 3600000
    help
        Initial delay before making first reconnect attempt, if the AWS IoT connection fails.
        Client will perform exponential backoff, starting from this value.

config AWS_IOT_MQTT_MAX_RECONNECT_WAIT_INTERVAL
    int "Auto reconnect maximum interval (ms)"
    default 128000
    range 10 3600000
    help
        Maximum delay between reconnection attempts. If the exponentially increased delay
        interval reaches this value, the client will stop automatically attempting to reconnect.


config AWS_IOT_OVERRIDE_THING_SHADOW_RX_BUFFER
    bool "Override Shadow RX buffer size"
    default n
    help
        Allows setting a different Thing Shadow RX buffer
        size. This is the maximum size of a Thing Shadow
        message in bytes, plus one.

        If not overridden, the default value is the MQTT RX Buffer length plus one. If overriden, do not set
        higher than the default value.

config AWS_IOT_SHADOW_MAX_SIZE_OF_RX_BUFFER
    int "Maximum RX Buffer (bytes)"
    default 513
    range 32 65536
    help
        Allows setting a different Thing Shadow RX buffer size.
        This is the maximum size of a Thing Shadow message in bytes,
        plus one.


config AWS_IOT_SHADOW_MAX_SIZE_OF_UNIQUE_CLIENT_ID_BYTES
    int "Maximum unique client ID size (bytes)"
    default 80
    range 4 1000
    help
        Maximum size of the Unique Client Id.

config AWS_IOT_SHADOW_MAX_SIMULTANEOUS_ACKS
        int "Maximum simultaneous responses"
        default 10
        range 1 100
        help
            At any given time we will wait for this many responses. This will correlate to the rate at which the
            shadow actions are requested

config AWS_IOT_SHADOW_MAX_SIMULTANEOUS_THINGNAMES
        int "Maximum simultaneous Thing Name operations"
        default 10
        range 1 100
        help
            We could perform shadow action on any thing Name and this is maximum Thing Names we can act on at any
            given time

config AWS_IOT_SHADOW_MAX_JSON_TOKEN_EXPECTED
        int "Maximum expected JSON tokens"
        default 120
        help
            These are the max tokens that is expected to be in the Shadow JSON document. Includes the metadata which
            is published

config AWS_IOT_SHADOW_MAX_SHADOW_TOPIC_LENGTH_WITHOUT_THINGNAME
        int "Maximum topic length (not including Thing Name)"
        default 60
        range 10 1000
        help
            All shadow actions have to be published or subscribed to a topic which is of the format
            $aws/things/{thingName}/shadow/update/accepted. This refers to the size of the topic without the Thing
            Name

config AWS_IOT_SHADOW_MAX_SIZE_OF_THING_NAME
        int "Maximum Thing Name length"
        default 20
        range 4 1000
        help
            Maximum length of a Thing Name.

endmenu
```
